## main/Kconfig.projbuild
```kconfig
menu "Example Configuration"

    menu "TinyUSB Configuration"

        config TUSB_VID
            hex "USB Device VID"
            default 0x303A
        config TUSB_PID
            hex "USB Device PID"
            default 0x2986 if UAC_AUDIO_ENABLE
            default 0x2987 if !UAC_AUDIO_ENABLE
        config TUSB_MANUFACTURER
            string "USB Device Manufacture"
            default "Espressif"
        config TUSB_PRODUCT
            string "Product Name"
            default "Vendor"

        choice TINYUSB_RHPORT
            depends on IDF_TARGET_ESP32P4
            prompt "TinyUSB PHY"
            default TINYUSB_RHPORT_HS
            help
                Allows set the USB PHY Controller for TinyUSB: HS (USB OTG2.0 PHY for HighSpeed)

            config TINYUSB_RHPORT_HS
                bool "HS"
        endchoice

    endmenu

    menu "USB extend screen configuration"
        config USB_EXTEND_SCREEN_USB_STABILITY_TEST_MODE
            bool "USB stability test mode (disable LCD/DSI)"
            default n
            help
                Disable LCD/DSI init and frame rendering, keep only USB enumeration
                and USB data-path activity for firmware/host driver stability tests.

        config USB_EXTEND_SCREEN_HEIGHT
            int "USB extend screen height"
            default 1024 if IDF_TARGET_ESP32P4
            default 320
            help
                USB extend screen height

        config USB_EXTEND_SCREEN_WIDTH
            int "USB extend screen width"
            default 576 if IDF_TARGET_ESP32P4
            default 240
            help
                USB extend screen width

        config USB_EXYEEND_SCREEN_JEPG_QUALITY
            int "USB extend screen jpeg quality"
            default 6
            range 1 10
            help
                USB extend screen jpeg quality

        config USB_EXTEND_SCREEN_MAX_FPS
            int "USB extend screen max fps"
            default 30 if IDF_TARGET_ESP32P4
            default 30
            range 1 60
            help
                USB extend screen max fps

        config USB_EXTEND_SCREEN_FRAME_LIMIT_B
            int "Maximum frame image (B)"
            default 300000 if IDF_TARGET_ESP32P4
            default 100000
            help
                The maximum length of a single frame image transmitted from Windows.

        config USB_EXTEND_SCREEN_RX_FRAME_BUFFER_COUNT
            int "USB receive frame buffer count"
            default 12 if IDF_TARGET_ESP32P4
            default 6
            range 4 32
            help
                Number of compressed frame buffers used between TinyUSB RX and the
                display pipeline. Larger values give USB more breathing room at the
                cost of additional PSRAM usage and worst-case latency.

        config USB_EXTEND_SCREEN_JPEG_DECODE_RING_COUNT
            int "JPEG decode ring buffer count"
            depends on IDF_TARGET_ESP32P4
            default 4
            range 2 8
            help
                Number of aligned RGB888 decode output buffers used to decouple JPEG
                decode from framebuffer copy/DSI refresh.
    endmenu

    config USB_TASK_PRIORITY
        int "USB Task Priority"
        default 6
        range 1 15
        help
            TinyUSB main task priority

    config VENDOR_TASK_PRIORITY
        int "Vendor Task Priority"
        default 5
        range 1 15
        help
            Task to receive JPG data from PC

    config HID_TOUCH_ENABLE
        bool "Enable HID Touch Report"
        default y
        help
            Enable this option to allow HID touch events to be reported.
            If disabled, touch events will not be processed or sent.

    config HID_TASK_PRIORITY
        int "HID Task Priority"
        depends on  HID_TOUCH_ENABLE
        default 5
        range 1 15
        help
            Task to transmit touch data to PC

    config TOUCH_TASK_PRIORITY
        int "Touch Task Priority"
        depends on  HID_TOUCH_ENABLE
        default 5
        range 1 15
        help
            Task to read touch data from i2s

    config UAC_AUDIO_ENABLE
        bool
        default n

    config EXAMPLE_ENABLE_PRINT_FPS_RATE_VALUE
        bool "enable print fps rate value"
        default y

    config EXAMPLE_LCD_BUF_COUNT
        int "LCD Buffer Count"
        depends on IDF_TARGET_ESP32P4
        default 2
        range 1 3

    choice
        prompt "Choose the color format of the LCD"
        default LCD_PIXEL_FORMAT_RGB565
            config LCD_PIXEL_FORMAT_RGB565
                bool "RGB565"

            config LCD_PIXEL_FORMAT_RGB888
                bool "RGB888"
                depends on IDF_TARGET_ESP32P4
    endchoice
endmenu
```

## ports/jc4880p443/sdkconfig.defaults
```kconfig
CONFIG_IDF_TARGET="esp32p4"
CONFIG_ESP32P4_SELECTS_REV_LESS_V3=n
CONFIG_ESP32P4_REV_MIN_301=y
CONFIG_ESP32P4_REV_MIN_FULL=301
CONFIG_ESP_DEFAULT_CPU_FREQ_MHZ_400=y
CONFIG_ESPTOOLPY_FLASHMODE_QIO=y
CONFIG_ESPTOOLPY_FLASHSIZE_16MB=y
CONFIG_PARTITION_TABLE_CUSTOM=y
CONFIG_PARTITION_TABLE_CUSTOM_FILENAME="partitions.csv"
CONFIG_PARTITION_TABLE_OFFSET=0x9000
CONFIG_SPIRAM=y
CONFIG_SPIRAM_MODE_HEX=y
CONFIG_SPIRAM_SPEED_200M=y
CONFIG_SPIRAM_XIP_FROM_PSRAM=y
CONFIG_SPIRAM_MALLOC_ALWAYSINTERNAL=16384
CONFIG_CACHE_L2_CACHE_128KB=y
CONFIG_CACHE_L2_CACHE_LINE_128B=y
CONFIG_ESP_CONSOLE_USB_SERIAL_JTAG=y
CONFIG_FREERTOS_HZ=1000
CONFIG_ESP_MAIN_TASK_STACK_SIZE=8192
CONFIG_COMPILER_OPTIMIZATION_PERF=y
CONFIG_LIBC_NEWLIB=y
CONFIG_LIBC_PICOLIBC=n
CONFIG_LCD_DSI_ISR_CACHE_SAFE=n
```

## sdkconfig.defaults.esp32p4
```kconfig
CONFIG_IDF_TARGET="esp32p4"
CONFIG_EXAMPLE_LCD_BUF_COUNT=3
CONFIG_LCD_PIXEL_FORMAT_RGB888=y
CONFIG_COMPILER_ORPHAN_SECTIONS_PLACE=y
CONFIG_ESP32P4_REV_MIN_1=y
CONFIG_SPIRAM=y
CONFIG_SPIRAM_SPEED_200M=y
CONFIG_FREERTOS_HZ=1000
CONFIG_IDF_EXPERIMENTAL_FEATURES=y
CONFIG_COMPILER_OPTIMIZATION_PERF=y
CONFIG_CACHE_L2_CACHE_256KB=y
CONFIG_CACHE_L2_CACHE_LINE_128B=y
CONFIG_TUSB_PID=0x2987
CONFIG_UAC_AUDIO_ENABLE=n
CONFIG_USB_EXTEND_SCREEN_HEIGHT=452
CONFIG_USB_EXTEND_SCREEN_WIDTH=1280
CONFIG_USB_EXTEND_SCREEN_RX_FRAME_BUFFER_COUNT=12
CONFIG_USB_EXTEND_SCREEN_JPEG_DECODE_RING_COUNT=4
# CONFIG_USB_EXTEND_SCREEN_USB_STABILITY_TEST_MODE is not set
```
